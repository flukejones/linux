## drivers/iio/imu/bmi260/Kconfig
```kconfig
# SPDX-License-Identifier: GPL-2.0-only
#
# BMI260 IMU driver
#

config BMI260
	tristate
	select IIO_BUFFER
	select IIO_TRIGGERED_BUFFER

config BMI260_I2C
	tristate "Bosch BMI260 I2C driver"
	depends on I2C
	select BMI260
	select REGMAP_I2C
	help
	  If you say yes here you get support for BMI260 IMU on I2C with
	  accelerometer, gyroscope and external BMG260 magnetometer.

	  This driver can also be built as a module. If so, the module will be
	  called bmi260_i2c.
```
